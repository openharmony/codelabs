## Device/WifiDemo/device_hisilicon_drivers/wifi/driver/Kconfig
```kconfig
#
# Copyright (C) 2021 HiSilicon (Shanghai) Technologies CO., LIMITED.
#
# This program is free software; you can redistribute it and/or
# modify it under the terms of the GNU General Public License
# as published by the Free Software Foundation; either version 2
# of the License, or (at your option) any later version.
#
# This program is distributed in the hope that it will be useful,
# but WITHOUT ANY WARRANTY; without even the implied warranty of
# MERCHANTABILITY or FITNESS FOR A PARTICULAR PURPOSE.  See the
# GNU General Public License for more details.
#
# You should have received a copy of the GNU General Public License
# along with this program; if not, write to the Free Software
# Foundation, Inc., 51 Franklin Street, Fifth Floor, Boston, MA  02110-1301, USA.
#
config DRIVERS_HDF_WIFI
    bool "Enable HDF WiFi Host driver"
    default n
    depends on DRIVERS_HDF
    help
      Answer Y to enable HDF WiFi Host driver.

config DRIVERS_HI3881
    bool "Enable Hi3881 Host driver"
    default n
    depends on DRIVERS_HDF_WIFI
    help
      Answer Y to enable Hi3881 Host driver.
```
